
#include "BluetoothSerial.h"
#include <Wire.h>
#include <Adafruit_GFX.h>
#include <Adafruit_SSD1306.h>

#if !defined(CONFIG_BT_ENABLED) || !defined(CONFIG_BLUEDROID_ENABLED)
#error Bluetooth is not enabled! Please run `make menuconfig` to and enable it
#endif

// Screen dettings
#define SCREEN_WIDTH 128
#define SCREEN_HEIGHT 64

BluetoothSerial SerialBT;

Adafruit_SSD1306 display(SCREEN_WIDTH, SCREEN_HEIGHT, &Wire, -1);

// Bitmap Matrix
static const uint8_t image_data_Saraarray[1024] ={
0x00, 0x00, 0x00, 0x00, 0x00, 0x00, 0x00, 0x00, 0x00, 0x00, 0x00, 0x00, 0x00, 0x00, 0x00, 0x00, 
0x00, 0x00, 0x00, 0x00, 0x00, 0x00, 0x00, 0x00, 0x00, 0x00, 0x00, 0x00, 0x00, 0x00, 0x00, 0x00, 
0x00, 0x00, 0x00, 0x00, 0x00, 0x00, 0x00, 0x00, 0x00, 0x00, 0x00, 0x00, 0x00, 0x00, 0x00, 0x00, 
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0x00, 0x00, 0x00, 0x00, 0x02, 0x00, 0x00, 0x00, 0x00, 0x04, 0x00, 0x00, 0x00, 0x40, 0x00, 0x00
};


int count = 0;

int speed = 0;
int soc = 0;
int distance = 0;

char Char_Sp[8];
char Char_Soc[8];
char Char_Dis[8];
char data[50];


void setup() {
  Serial.begin(115200);
  SerialBT.begin("E_Bicycle_v1"); // Bluetooth device name
  Serial.println("The device started, now you can pair it with bluetooth!");

  // Start I2C Communication SDA = 5 and SCL = 4 on Wemos Lolin32 ESP32 with built-in SSD1306 OLED
  Wire.begin(5, 4);

  if(!display.begin(SSD1306_SWITCHCAPVCC, 0x3C, false, false)) {
    Serial.println(F("SSD1306 allocation failed"));
    for(;;);
  }
  delay(2000); // Pause for 2 seconds
 
  // Clear the buffer.
  display.clearDisplay();
  
  // Draw bitmap on the screen
  display.drawBitmap(0, 0, image_data_Saraarray, 128, 64, 1);
  display.display();
  
}

void loop() {

  if (SerialBT.available()) {
    Serial.write(SerialBT.read());
  }
  
  delay(20);

  data[0] = 0;


  if (count > 30) {
    speed = speed + 1;
    soc = soc + 2;
    distance = distance + 3;

    if (distance >99) {
      speed = 0;
      soc = 0;
      distance = 0;
    }
    count = 0;
  }
  count = count + 1;
  
  strcat(data,"/");
  dtostrf(speed,2,1,Char_Sp);
  strcat(data,Char_Sp);
  strcat(data,":");

  dtostrf(soc,2,1,Char_Soc);
  strcat(data,Char_Soc);
  strcat(data,":");

  dtostrf(distance,2,1,Char_Dis);
  strcat(data,Char_Dis);
  strcat(data,"/");

  for (int c=0; c< strlen(data); c++){
    SerialBT.write(data[c]);
  }
  

}

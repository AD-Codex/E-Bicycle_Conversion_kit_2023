#include "BluetoothSerial.h"
#include <Wire.h>
#include <Adafruit_GFX.h>
#include <Adafruit_SSD1306.h>

#if !defined(CONFIG_BT_ENABLED) || !defined(CONFIG_BLUEDROID_ENABLED)
#error Bluetooth is not enabled! Please run `make menuconfig` to and enable it
#endif

// screen settings
#define SCREEN_WIDTH 128
#define SCREEN_HEIGHT 64

// Blu deffine
BluetoothSerial SerialBT;

// 25, 26, 16, 0, 2, 14, 12, 13, 15, 36, 39 pins
// encode valu - 12
// 4RPM - 28.27 cm = 0.2827 m 

// ------------------------------- ESP pins ----------------------------------
const int BLU_LED = 16;       // B 66
const int ELC_MOD = 14;       // E-on 69, E-off 70
const int AUTO_MOD = 0;       // A-on 65, A-0ff 67
const int Break_MOD = 2;      // S-stop 83, R-run 82

const int EncoderPin = 25;
const int potPin = 39;
const int I_sen = 36;
const int V_sen = 26;

const int M_PWM = 15;
const int M_INA = 13;
const int M_INB = 12;
// ----------------------------------------------------------------------

// Mode status -----------------------------------------------------------
int BLU_MOD =0;
int E_MOD = 0;
int A_MOD = 0;
int B_MOD = 0;
int LoopCount =0;
// -----------------------------------------------------------------------

// sensor veriable -------------------------------------------------------
float potValue = 0;
float V_value = 0;
float I_value = 0;
// ------------------------------------------------------------------------


// BLU veriables ----------------------------------------------------------------
int count = 0;
float speed = 0;
int soc = 0;
int distance = 0;
char Char_Sp[8];
char Char_Soc[8];
char Char_Dis[8];
char data[50];
// -------------------------------------------------------------------------------


// Setting PWM properties ---------------------------------------------------------------------
const int freq = 30000;
const int pwmChannel = 0;
const int resolution = 8;
int dutyCycle = 0;
int NotMapDutyCycle;
// ---------------------------------------------------------------------------


// RPM sensor const -----------------------------------------------------------------
const byte PulsesPerRevolution = 12;
const unsigned long ZeroTimeout = 100000;
const byte numReadings = 2;

volatile unsigned long LastTimeWeMeasured;
volatile unsigned long PeriodBetweenPulses = ZeroTimeout + 1000;
volatile unsigned long PeriodAverage = ZeroTimeout + 1000;
unsigned long FrequencyRaw;
unsigned long FrequencyReal;
unsigned long RPM;
unsigned int PulseCounter = 1;
unsigned long PeriodSum;

unsigned long LastTimeCycleMeasure = LastTimeWeMeasured;
unsigned long CurrentMicros = micros();
unsigned int AmountOfReadings = 1;
unsigned int ZeroDebouncingExtra;
unsigned long readings[numReadings];
unsigned long readIndex;  
unsigned long total; 
unsigned long average;
float TotalCount =0;
// ---------------------------------------------------------------------




// bitmap image -----------------------------------------------------------------
Adafruit_SSD1306 display(SCREEN_WIDTH, SCREEN_HEIGHT, &Wire, -1);

static const uint8_t image_data_Saraarray[1024] ={
0x00, 0x00, 0x00, 0x00, 0x00, 0x00, 0x00, 0x00, 0x00, 0x00, 0x00, 0x00, 0x00, 0x00, 0x00, 0x00, 
0x00, 0x00, 0x00, 0x00, 0x00, 0x00, 0x00, 0x00, 0x00, 0x00, 0x00, 0x00, 0x00, 0x00, 0x00, 0x00, 
0x00, 0x00, 0x00, 0x00, 0x00, 0x00, 0x00, 0x00, 0x00, 0x00, 0x00, 0x00, 0x00, 0x00, 0x00, 0x00, 
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0x00, 0x00, 0x00, 0x00, 0x02, 0x00, 0x00, 0x00, 0x00, 0x04, 0x00, 0x00, 0x00, 0x40, 0x00, 0x00
};
// --------------------------------------------------------------------------------




void setup() {
  Serial.begin(115200);
  SerialBT.begin("E_Bicycle_v1"); // Bluetooth device name
  Serial.println("The device started, now you can pair it with bluetooth!");

  // Start I2C Communication SDA = 5 and SCL = 4 on Wemos Lolin32 ESP32 with built-in SSD1306 OLED
  Wire.begin(5, 4);

  if(!display.begin(SSD1306_SWITCHCAPVCC, 0x3C, false, false)) {
    Serial.println(F("SSD1306 allocation failed"));
    for(;;);
  }
  delay(2000); // Pause for 2 seconds
 
  // Clear the buffer.
  display.clearDisplay();
  
  // Draw bitmap on the screen
  display.drawBitmap(0, 0, image_data_Saraarray, 128, 64, 1);
  display.display();

  // Interrupt set
  attachInterrupt(digitalPinToInterrupt(EncoderPin), Pulse_Event, FALLING);

  // pinMode set 
  pinMode(BLU_LED, OUTPUT);
  pinMode(ELC_MOD, OUTPUT);
  pinMode(AUTO_MOD, OUTPUT);
  pinMode(Break_MOD, OUTPUT);

  pinMode(M_PWM, OUTPUT);
  pinMode(M_INA, OUTPUT);
  pinMode(M_INB, OUTPUT);

  pinMode(potPin, INPUT);
  pinMode(I_sen, INPUT);
  pinMode(V_sen, INPUT);

  // OnStart LED
  digitalWrite(BLU_LED, LOW);
  digitalWrite(ELC_MOD, LOW);
  digitalWrite(AUTO_MOD, LOW);
  digitalWrite(Break_MOD, LOW);

  // Turn off motors - Initial state
	digitalWrite(M_INA, LOW);
	digitalWrite(M_INB, LOW);
	digitalWrite(M_PWM, LOW);

  // configure LED PWM functionalitites
  ledcSetup(pwmChannel, freq, resolution);
  
  // // attach the channel to the GPIO to be controlled
  ledcAttachPin(M_PWM, pwmChannel);


}

void loop() {

  // BLU RX read -----------------------------------------------------------
  if (SerialBT.available()) {
    char a = SerialBT.read();
    Serial.write(a);
    if (a==66) { // blu
      digitalWrite(BLU_LED, HIGH);
    }
    else if (a==83) { // stop
      digitalWrite(Break_MOD, HIGH);
      B_MOD=1;
    }
    else if (a==82) { // run
      digitalWrite(Break_MOD, LOW);
      B_MOD=0;
    }
    else if (a==69) { // Electric mode on
      digitalWrite(ELC_MOD, HIGH);
      E_MOD =1;
    }
    else if (a==70) { // electric mode off
      digitalWrite(ELC_MOD, LOW);
      E_MOD =0;
    }
    else if (a==65) { // auto mode on
      digitalWrite(AUTO_MOD, HIGH);
      A_MOD =1;
    }
    else if (a==67) { // auto mode off
      digitalWrite(AUTO_MOD, LOW);
      A_MOD =0;
    }
  }
  // -----------------------------------------------------------------------------
    
  delay(20);

  // pot read ---------------------------------------------------------------
  potValue = (analogRead(potPin)/4095.0)*255;
  if (potValue <=100) {
    potValue=100;
  } else if (potValue >=200) {
    potValue = 200;
  }
  dutyCycle = map(potValue, 100,200,0,255);
  // Serial.println(dutyCycle);

  // V_value = analogRead(V_sen);

  // I_value = analogRead(I_sen)*5/(4095.0*0.140);
  soc = 89.5;
  // Serial.println(soc);
  

  if (A_MOD==1) {
    if (B_MOD==0){
      digitalWrite(M_INA, LOW);
      digitalWrite(M_INB, HIGH);
      ledcWrite(pwmChannel, 200);
    }
    else if (B_MOD==1) {
      digitalWrite(M_INA, LOW);
      digitalWrite(M_INB, LOW);
      ledcWrite(pwmChannel, 0);
    }
  }
  else if (E_MOD==1) {
    digitalWrite(M_INA, LOW);
    digitalWrite(M_INB, HIGH);
    ledcWrite(pwmChannel, dutyCycle);
  }
  else if (E_MOD==0){
    digitalWrite(M_INA, LOW);
    digitalWrite(M_INB, LOW);
    ledcWrite(pwmChannel, 0);
  }

  // ------------------------------------------------------------------------


  // RPM read ----------------------------------------------------------------
  LastTimeCycleMeasure = LastTimeWeMeasured;
  CurrentMicros = micros();
  if (CurrentMicros < LastTimeCycleMeasure) {
    LastTimeCycleMeasure = CurrentMicros;
  }
  FrequencyRaw = 10000000000 / PeriodAverage;
  if (PeriodBetweenPulses > ZeroTimeout - ZeroDebouncingExtra || CurrentMicros - LastTimeCycleMeasure > ZeroTimeout - ZeroDebouncingExtra) {
    FrequencyRaw = 0;  // Set frequency as 0.
    ZeroDebouncingExtra = 2000;
  } else {
    ZeroDebouncingExtra = 0;
  }
  FrequencyReal = FrequencyRaw / 100000;

  TotalCount = TotalCount + FrequencyRaw/12;

  RPM = FrequencyRaw / PulsesPerRevolution * 60;
  RPM = RPM / 10000;
  total = total - readings[readIndex];
  readings[readIndex] = RPM;
  total = total + readings[readIndex];
  readIndex = readIndex + 1;

  if (readIndex >= numReadings) {
    readIndex = 0;
  }
  average = total / numReadings;
  speed = RPM*7.53*60/100000; // m_p_s
  // Serial.println(speed);
  // Serial.println(TotalCount);
  distance = TotalCount*7.53/(12*1000000);

  // ----------------------------------------------------------------------------



  // BLU protocl --------------------------------------------------------------
 
  // if (count > 50) {
    // speed = speed + 1;
    // soc = soc + 2;
    // distance = distance + 3;
    // if (distance >99) {
      // speed = 0;
      // soc = 0;
  //     distance = 0;
  //   }
  //   count = 0;
  // }
  // count = count + 1;
  
   data[0] = 0;
  strcat(data,"/");
  dtostrf(speed,2,1,Char_Sp);
  strcat(data,Char_Sp);
  strcat(data,":");
  dtostrf(soc,2,1,Char_Soc);
  strcat(data,Char_Soc);
  strcat(data,":");
  dtostrf(distance,2,1,Char_Dis);
  strcat(data,Char_Dis);
  strcat(data,"/");

  for (int c=0; c< strlen(data); c++){
    SerialBT.write(data[c]);
  }
  // -----------------------------------------------------------------------
  

}


// inturrupt function ---------------------------------------------------------
void Pulse_Event() {
  PeriodBetweenPulses = micros() - LastTimeWeMeasured;
  LastTimeWeMeasured = micros();
  if (PulseCounter >= AmountOfReadings)  {
    PeriodAverage = PeriodSum / AmountOfReadings;
    PulseCounter = 1;
    PeriodSum = PeriodBetweenPulses;

    int RemapedAmountOfReadings = map(PeriodBetweenPulses, 40000, 5000, 1, 10);
    RemapedAmountOfReadings = constrain(RemapedAmountOfReadings, 1, 10);
    AmountOfReadings = RemapedAmountOfReadings;
  } else {
    PulseCounter++;
    PeriodSum = PeriodSum + PeriodBetweenPulses;
  }
}
// -------------------------------------------------------------------------------
